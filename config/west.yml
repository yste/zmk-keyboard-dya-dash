## config/west.yml
```yaml
manifest:
  defaults:
    remote: cormoran
    revision: main
  remotes:
    - name: cormoran
      url-base: https://github.com/cormoran
  projects:
    - name: zmk
      import: app/west.yml
    - name: zmk-pmw3610-driver
    - name: zmk-feature-default-layer
    - name: zmk-driver-animation
    - name: zmk-driver-ext-power-transient
  self:
    path: config
```
